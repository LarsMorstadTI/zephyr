/*
 * Copyright (c) 2026 Texas Instruments Incorporated
 *
 * SPDX-License-Identifier: Apache-2.0
 */

/ {
	resources {
		compatible = "test-gpio-basic-api";
		/* Use DIO1 and DIO2 for GPIO loopback testing */
		out-gpios = <&gpio0 1 0>;  /* DIO1 */
		in-gpios = <&gpio0 2 0>;   /* DIO2 */
	};
};
