/*
 * Copyright (c) 2026 Texas Instruments Incorporated
 *
 * SPDX-License-Identifier: Apache-2.0
 */

/ {
	aliases {
		counter = &lgpt0;
	};
};

/* Use lgpt0 for counter tests */
&lgpt0 {
	clk-prescale = <32>;
	status = "okay";
};

/* Disable lgpt1 to avoid conflicts */
&lgpt1 {
	status = "disabled";
};
