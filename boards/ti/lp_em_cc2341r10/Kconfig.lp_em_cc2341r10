## boards/ti/lp_em_cc2341r10/Kconfig.lp_em_cc2341r10
```kconfig
# Copyright (c) 2026 Texas Instruments Incorporated
#
# SPDX-License-Identifier: Apache-2.0

config BOARD_LP_EM_CC2341R10
	select SOC_CC2341R10
```

## boards/ti/lp_em_cc2341r10/board.yml
```yaml
board:
  name: lp_em_cc2341r10
  full_name: CC2341R10 LaunchPad
  vendor: ti
  socs:
    - name: cc2341r10
```

## dts/bindings/i2c/ti,cc23xx-cc27xx-i2c.yaml
```yaml
# Copyright (c) 2024 Baylibre, SAS
#
# SPDX-License-Identifier: Apache-2.0

description: TI CC23xx/CC27xx I2C node

compatible: "ti,cc23xx-cc27xx-i2c"

include: [i2c-controller.yaml, pinctrl-device.yaml, base.yaml]

properties:
  reg:
    required: true

  interrupts:
    required: true

  pinctrl-0:
    required: true

  pinctrl-names:
    required: true

  clock-id:
    type: int
    required: true
    description: |
      CLKCTL peripheral clock gate ID for this I2C instance, as passed to
      CLKCTLEnable(). On CC23X0 and CC27XX this is the CLKENSET0 mask, so
      CLKCTL_I2C0 is 0x40. On CC23X1 it is the bit index, so CLKCTL_I2C0
      is 6 and CLKCTL_I2C1 is 7.
```

## soc/ti/simplelink/cc23x1/Kconfig
```kconfig
# Copyright (c) 2026 Texas Instruments Incorporated
#
# SPDX-License-Identifier: Apache-2.0

config SOC_SERIES_CC23X1
	select ARM
	select CPU_CORTEX_M0PLUS
	select CPU_CORTEX_M_HAS_VTOR
	select SOC_RESET_HOOK
	select DYNAMIC_INTERRUPTS
	select HAS_CC23X1_SDK
	select HAS_TI_CCFG if !BOOTLOADER_MCUBOOT
	select HAS_TI_SCFG if !BOOTLOADER_MCUBOOT
	select TI_SIMPLELINK_DYNAMIC_DPL_OBJECTS
	select EVENTS
	select THREAD_STACK_INFO
	select HAS_PM
	select PM_DEVICE if PM
	select HAS_POWEROFF
	select HAS_SEGGER_RTT if ZEPHYR_SEGGER_MODULE
	select PM_DEVICE_DRIVER_NEEDS_DEDICATED_WQ if PM_DEVICE_RUNTIME

menu "Customer Configuration (CCFG)"
depends on SOC_SERIES_CC23X1

menu "Bootloader Configuration"

choice CC23X1_BLDR_VTOR_TYPE
	prompt "Pointer to user bootloader vector table"
	default CC23X1_BLDR_VTOR_TYPE_USE_FCFG

config CC23X1_BLDR_VTOR_TYPE_UNDEF
	bool "ROM serial bootloader"

config CC23X1_BLDR_VTOR_TYPE_FORBID
	bool "No bootloader invoked"

config CC23X1_BLDR_VTOR_TYPE_USE_FCFG
	bool "Use factory configuration"

config CC23X1_BLDR_VTOR_TYPE_FLASH
	bool "Use valid main flash address"

endchoice # CC23X1_BLDR_VTOR_TYPE

config CC23X1_BLDR_VTOR_FLASH
	hex "User bootloader vector table address" if CC23X1_BLDR_VTOR_TYPE_FLASH
	range 0 0x0effffff
	default 0
	help
	  Whether a bootloader is run or not and where bootloader parameters are picked from
	  depends on this address. If a bootloader is selected then that bootloader is always
	  invoked as part of the boot process.

config CC23X1_BLDR_ENABLED
	bool "Bootloader commands"
	default n
	help
	  If n, bootloader ignores all commands.

config CC23X1_SERIAL_IO_CFG_INDEX
	int "Serial IO configuration index"
	range 0 7
	default 0
	help
	  Index of which I/O mapping to use for UART/SPI.

config CC23X1_PIN_TRIGGER_ENABLED
	bool "Pin trigger"
	default n
	help
	  If n, bootloader unconditionally triggers. Else normal pin trigger check is performed.

config CC23X1_PIN_TRIGGER_DIO
	int "Trigger DIO pin" if CC23X1_PIN_TRIGGER_ENABLED
	range 0 63
	default 0
	help
	  Index of DIO pin to use for pin trigger check.

config CC23X1_PIN_TRIGGER_LEVEL_HI
	bool "Trigger level high" if CC23X1_PIN_TRIGGER_ENABLED
	default n
	help
	  Level on trigger pin that triggers bootloader.
	  n = Low, y = High.

config CC23X1_P_APP_VTOR
	hex "Application vector table address"
	range 0 0xffffffff
	default 0x00000000
	help
	  User application start address.

endmenu # "Bootloader Configuration"
menu "Device Permission Settings"

config CC23X1_ALLOW_DEBUG_PORT
	bool "Allow enabling of SWD port"
	default y
	help
	  If n, then the SWD port is disabled altogether at a certain point in boot before
	  invoking either bootloader or application.

config CC23X1_ALLOW_ENERGY_TRACE
	bool "Allow using EnergyTrace power analyzer tool"
	default y
	help
	  EnergyTrace software is an energy-based code analysis tool that measures
	  and displays the energy profile of an application and helps optimize it for
	  ultra-low-power consumption.

config CC23X1_ALLOW_FLASH_VERIFY
	bool "Allow flash verify by SACI"
	default y
	help
	  Determines whether flash verify commands are allowed. These commands only check integrity
	  against a provided CRC32 value, never return any flash contents. Flash verify commands
	  are always allowed after a chip erase and until the first reset after the CCFG sector has
	  been programmed.

config CC23X1_ALLOW_FLASH_PROGRAM
	bool "Allow flash program by SACI"
	default y
	help
	  Determines whether flash programming commands are allowed.
	  Reset to allowed after a chip erase.

config CC23X1_ALLOW_CHIP_ERASE
	bool "Allow chip erase by SACI"
	default y
	help
	  Determines whether the chip erase command is allowed.

config CC23X1_ALLOW_TOOLS_CLIENT_MODE
	bool "Allow tools client mode to be enabled by SACI"
	default y
	help
	  Used by TI tools such as SmartRF Studio and Packet Sniffer to allow in-situ RF testing
	  on customer boards without disturbing the application stored in flash.

config CC23X1_ALLOW_RETURN_TO_FACTORY
	bool "Allow return-to-factory procedure by SACI"
	default y
	help
	  To do full failure analysis including flash, a return to factory procedure is supported.

endmenu # "Device Permission Settings"

menu "SACI Settings (Secure AP Command Interface)"

config CC23X1_SACI_TIMEOUT_OVERRIDE
	bool "Override SACI timeout"
	default n
	help
	  Determines if SACI timeout defined in FCFG is overridden by SACI timeout defined in CCFG.

config CC23X1_SACI_TIMEOUT_EXP
	int "SACI timeout" if CC23X1_SACI_TIMEOUT_OVERRIDE
	range 0 7
	default 0
	help
	  Configures the SACI timeout when there is a bootloader or application to boot into.
	  SACI timeout is infinite when 0, else (2 ^ saciTimeoutExp) * 64 ms.

config CC23X1_ALLOW_MAIN_APP_ERASE
	bool "Allow main app erase by SACI"
	default y


endmenu # "SACI Settings (Secure AP Command Interface)"

menu "Flash Protection Settings"

config CC23X1_WR_ER_PROT_SECT0_31
	hex "Write/Erase protection mask (sectors 0-31)"
	range 0 0xffffffff
	default 0xffffffff
	help
	  Bitmask for write/erase protection of individual sectors in sector range [0, 31].
	  Controls whether flash programming is allowed through SACI. The same mechanism
	  controls whether the application is allowed to program these sectors.
	  0 = protected.

config CC23X1_WR_ER_PROT_SECT32_255
	hex "Write/Erase protection mask (sectors 32-255)"
	range 0 0xffffffff
	default 0xffffffff
	help
	  Bitmask for write/erase protection of groups of 8 sectors.
	  Bit i protects sectors [32 + 8i, 39 + 8i].
	  0 = protected.

config CC23X1_WR_ER_PROT_SECT256_511
	hex "Write/Erase protection mask (sectors 256-511)"
	range 0 0xffffffff
	default 0xffffffff
	help
	  Bitmask for write/erase protection of groups of 8 sectors.
	  Bit i protects sectors [256 + 8i, 263 + 8i].
	  0 = protected.



config CC23X1_WR_ER_PROT_CCFG_SECT
	hex "Write/Erase protection mask (CCFG sectors)"
	range 0 1
	default 0
	help
	  Bitmask for write/erase protection of CCFG sectors.
	  0 = protected.

config CC23X1_WR_ER_PROT_FCFG_SECT
	hex "Write/Erase protection mask (FCFG sectors)"
	range 0 1
	default 0
	help
	  Bitmask for write/erase protection of FCFG sectors.
	  0 = protected.

config CC23X1_WR_ER_PROT_ENGR_SECT
	hex "Write/Erase protection mask (ENGR sectors)"
	range 0 1
	default 0
	help
	  Bitmask for write/erase protection of ENGR sectors.
	  0 = protected.

config CC23X1_WR_ER_PROT_SCFG_SECT
	hex "Write/Erase protection mask (SCFG sectors)"
	range 0 1
	default 0
	help
	  Bitmask for write/erase protection of ENGR sectors.
	  0 = protected.

config CC23X1_WR_ER_PROT_VLOG_SECT
	hex "Write/Erase protection mask (VLOG sectors)"
	range 0 1
	default 0
	help
	  Bitmask for write/erase protection of ENGR sectors.
	  0 = protected.

config CC23X1_READ_PROT_MAIN_SEC
	hex "Main sector read protection"
	range 0 0xf
	default 0xf

config CC23X1_READ_PROT_CCFG_SEC
	hex "CCFG sector read protection"
	range 0 0x3f
	default 0x3f

config CC23X1_CHIP_ER_RETAIN_SECT0_31
	hex "Chip erase protection mask (sectors 0-31)"
	range 0 0xffffffff
	default 0
	help
	  Bitmask for chip erase protection of individual sectors in sector range [0, 31].
	  Controls whether a chip erase affects a sector or not. The mechanism is intended
	  to allow flash sectors devoted to logging or runtime state/configuration to survive
	  the chip erase during a FW update.
	  0 = protected.

config CC23X1_CHIP_ER_RETAIN_SECT32_255
	hex "Chip erase protection mask (sectors 32-511)"
	range 0 0xffffffff
	default 0
	help
	  Bitmask for chip erase protection of groups of 8 sectors.
	  Bit i protects sectors [32 + 8i, 39 + 8i].
	  0 = protected.

config CC23X1_CHIP_ER_RETAIN_SECT256_511
	hex "Chip erase protection mask (sectors 256-511)"
	range 0 0xffffffff
	default 0
	help
	  Bitmask for chip erase protection of groups of 8 sectors.
	  Bit i protects sectors [256 + 8i, 263 + 8i].
	  0 = protected.





endmenu # "Flash Protection Settings"

endmenu # Customer Configuration (CCFG)

menu "Secure Configuration (SCFG)"
depends on SOC_SERIES_CC23X1

menu "Secure Bootloader Configuration"

choice CC23X1_POLICY_AUTH_METHOD
	prompt "Enable secure boot and choose authorization method"
	default CC23X1_POLICY_NO_AUTH

config CC23X1_POLICY_NO_AUTH
	bool "Disable Secure Boot entirely"

config CC23X1_POLICY_SIGNATURE
	bool "Signature"

config CC23X1_POLICY_HASH_LOCK
	bool "Hash Lock"

endchoice # CC23X1_POLICY_AUTH_METHOD

choice CC23X1_POLICY_AUTH_ALGORITHM
	prompt "Choose secure boot authentication algorithm"
	default CC23X1_POLICY_ALG_RSA_3K_SHA256

config CC23X1_POLICY_ALG_RSA_3K_SHA256
	bool "RSA 3K SHA256"

config CC23X1_POLICY_ALG_ECDSA_P256_SHA256
	bool "ECDSA P256 SHA256"

config CC23X1_POLICY_ALG_ECDSA_P521_SHA512
	bool "ECDSA P521 SHA512"

endchoice # CC23X1_POLICY_AUTH_ALGORITHM

choice CC23X1_POLICY_MODE
	prompt "Choose secure boot policy mode"
	default CC23X1_POLICY_MODE_XIPRD

config CC23X1_POLICY_MODE_OVRWRT
	bool "Policy Mode Overwrite"

config CC23X1_POLICY_MODE_XIPRE
	bool "Policy Mode XIP Revert Enabled"

config CC23X1_POLICY_MODE_XIPRD
	bool "Policy Mode XIP Revert Disabled"

endchoice # CC23X1_POLICY_MODE

endmenu # Secure Bootloader Configuration

menu "Device Permission Settings"

config CC23X1_ALLOW_DEBUG_PORT
	bool "Allow enabling of SWD port"
	default y
	help
	  If n, then the SWD port is disabled altogether at a certain point in boot before
	  invoking either bootloader or application.

config CC23X1_ALLOW_ENERGY_TRACE
	bool "Allow using EnergyTrace power analyzer tool"
	default y
	help
	  EnergyTrace software is an energy-based code analysis tool that measures
	  and displays the energy profile of an application and helps optimize it for
	  ultra-low-power consumption.

config CC23X1_ALLOW_FLASH_VERIFY
	bool "Allow flash verify by SACI"
	default y
	help
	  Determines whether flash verify commands are allowed. These commands only check integrity
	  against a provided CRC32 value, never return any flash contents. Flash verify commands
	  are always allowed after a chip erase and until the first reset after the CCFG sector has
	  been programmed.

config CC23X1_ALLOW_FLASH_PROGRAM
	bool "Allow flash program by SACI"
	default y
	help
	  Determines whether flash programming commands are allowed.
	  Reset to allowed after a chip erase.

config CC23X1_ALLOW_CHIP_ERASE
	bool "Allow chip erase by SACI"
	default y
	help
	  Determines whether the chip erase command is allowed.

config CC23X1_ALLOW_TOOLS_CLIENT_MODE
	bool "Allow tools client mode to be enabled by SACI"
	default y
	help
	  Used by TI tools such as SmartRF Studio and Packet Sniffer to allow in-situ RF testing
	  on customer boards without disturbing the application stored in flash.

config CC23X1_ALLOW_RETURN_TO_FACTORY
	bool "Allow return-to-factory procedure by SACI"
	default y
	help
	  To do full failure analysis including flash, a return to factory procedure is supported.

config CC23X1_ALLOW_MAIN_APP_ERASE
	bool "Allow main app ease by SACI. Only available for SCFG."
	default y
	help
	  Determines whether main app erase is enabled.

config CC23X1_ALLOW_FAKE_STANDBY
	bool "Allow fake standby."
	default y
	help
	  Determines whether fake standby is enabled.

endmenu # "Device Permission Settings"

menu "Fast Boot Settings"

choice CC23X1_FAST_BOOT
	prompt "Wakeup sources allowed to use fast boot"
	default CC23X1_FAST_BOOT_ANY
	help
	  Selects which wakeup sources from shutdown may skip parts of the boot
	  sequence to reduce wakeup time.

config CC23X1_FAST_BOOT_ANY
	bool "Any wakeup source"

config CC23X1_FAST_BOOT_IO
	bool "IO wakeup only"

config CC23X1_FAST_BOOT_TIMER
	bool "Timer wakeup only"

config CC23X1_FAST_BOOT_IO_OR_TIMER
	bool "IO or timer wakeup"

config CC23X1_FAST_BOOT_DISABLED
	bool "Fast boot disabled"

endchoice # CC23X1_FAST_BOOT

endmenu # "Fast Boot Settings"

endmenu # Secure Configuration (SCFG)
```

## soc/ti/simplelink/cc23x1/Kconfig.defconfig
```kconfig
# Texas Instruments SimpleLink CC23X1

# Copyright (c) 2026 Texas Instruments Incorporated
#
# SPDX-License-Identifier: Apache-2.0

if SOC_SERIES_CC23X1

config CPU_FREQUENCY
	int
	default 48000000

config SYS_CLOCK_HW_CYCLES_PER_SEC
	default 1000000

config SYS_CLOCK_TICKS_PER_SEC
	default 10000

config NUM_IRQS
	default 31

config BUILD_OUTPUT_BIN
	default n

endif
```

## tests/drivers/flash/common/Kconfig
```kconfig
# Copyright (c) 2024, Nordic Semiconductor ASA
# SPDX-License-Identifier: Apache-2.0

# Device/scenario dependent information that is not available in
# other ways.

DT_CHOSEN_Z_FLASH := zephyr,flash

config TEST_DRIVER_FLASH_SIZE
	int "Size of flash device under test"
	default $(dt_chosen_reg_size_int,$(DT_CHOSEN_Z_FLASH),0) \
		if (SOC_FAMILY_STM32 && !SOC_SERIES_STM32N6X)
	default -1
	help
	  Expected flash device size the test will validate against. If the flash driver does not
	  support the get_size() API, leave this set as -1 to skip the test.
	  For the STM32 devices, the flash size is directly given by the soc DTSI.

config TEST_FORCE_STORAGE_PARTITION
	bool "Force testing the storage partition area"
	default n
	help
	  This test prioritizes testing spi nor flash over
	  the storage area by default. Set this config to priorize
	  testing the storage partition instead.

config TEST_DRIVER_FLASH_TEST_AREA_OFFSET
	hex "Offset of the test area in the flash device under test"
	default 0xe0000 if SOC_SERIES_CC23X0 || SOC_SERIES_CC27XX
	default 0xff000
	help
	  Offset used by the test when it runs directly on a flash device
	  node instead of a partition. Lower it for devices where two
	  pages starting at the default offset do not fit in the device.

source "Kconfig.zephyr"
```
